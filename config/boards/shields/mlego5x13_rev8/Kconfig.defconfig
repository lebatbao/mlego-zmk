## config/boards/shields/mlego5x13_rev8/Kconfig.defconfig
```kconfig
# Copyright (c) 2022 The ZMK Contributors
# SPDX-License-Identifier: MIT

if SHIELD_MLEGO5x13_REV8

config ZMK_KEYBOARD_NAME
    default "custom 5x14"

config SPI
	default y

endif 
```
